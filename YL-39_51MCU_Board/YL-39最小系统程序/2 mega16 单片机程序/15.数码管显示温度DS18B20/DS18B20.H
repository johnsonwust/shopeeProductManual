
/******************************************************************/
//DS18B20连接在端口C的第7引脚
/******************************************************************/
//设置成输入
#define DQ_INPUT DDRC &= ~(1 << PC1)   
//设置成输出
#define DQ_OUT DDRC |= (1 << PC1)    
//设置成低电平
#define DQ_LO PORTC &= ~(1 << PC1)  
//设置成高电平
#define DQ_HI PORTC |= (1 << PC1)   
//读出
#define DQ_R PINC & (1 << PC1) 

/******************************************************************/
//DS18B20专用延时程序
/******************************************************************/
void delay_18B20(unsigned int x)  //1.5us左右 
{ 
     while(x) 
    { 
       x--; 
    } 
} 

/******************************************************************/
//初始化DS18B20
/******************************************************************/
void Init_1820() 
{ 
  
    DQ_OUT;
	DQ_HI;
	DQ_LO;
    delay_18B20(3000);    //480us以上 
	DQ_HI;
	DQ_INPUT;
    delay_18B20(50);     //15~60us 
	while(DQ_R);
	DQ_OUT;
	DQ_HI;
    delay_18B20(150);   //60~240us 
} 
/******************************************************************/
//写入一个字节入DS18B20
/******************************************************************/
Write_1820(unsigned char x) 
{    
    unsigned char m; 
    for(m=0;m<8;m++) 
    { 
	   DQ_LO;
       if(x&(1<<m))    //写数据，从低位开始 
	   DQ_HI;
       else 
	   DQ_LO;
       delay_18B20(40);   //15~60us 
	   DQ_HI;
    } 
	   DQ_HI;
} 
/******************************************************************/
//读出一个字节入DS18B20
/******************************************************************/
unsigned char Read_1820() 
{     
    unsigned char temp,k,n; 
       temp=0; 
    for(n=0;n<8;n++) 
       { 
	   DQ_LO;
	   DQ_HI;
	   DQ_INPUT;
       k=(DQ_R);    //读数据,从低位开始 
       if(k) 
       temp|=(1<<n); 
       else
       temp&=~(1<<n); 
       delay_18B20(50); //60~120us     
	   DQ_OUT;
       } 
   return (temp); 
}  