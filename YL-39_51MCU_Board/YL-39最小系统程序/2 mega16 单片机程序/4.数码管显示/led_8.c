/******************************************************************************/
/*【编写时间】： 2011.07.07
* 【作    者】： 雁翎电子
* 【版    本】： V1.0
* 【网    站】： http://ylelectronic.taobao.com/ 
* 【Q      Q】： 348439350
* 【编译环境】： ICCAVR  
* 【函数功能】： 数码管显示1234 
* 【晶    振】:  8M		
* 【芯    片】:  ATMEGA16A	 
* 【硬件连接】： J2短路帽接上  
/******************************************************************************/  

      #define uchar unsigned char
	  #define uint  unsigned int
	  #include <iom16v.h>
	  #define Set_Bit(val, bitn)    (val |=(1<<(bitn))) 
      #define Clr_Bit(val, bitn)    (val&=~(1<<(bitn))) 
      #define Get_Bit(val, bitn)    (val &(1<<(bitn)) ) 
      uchar  disbuf[4]={1,2,3,4};
      uchar  discode[10]={ 0xC0, 0xF9,0xA4,0xB0,0x99,0x92,0x82,0xF8,0x80,0x90 };  //段码表
      uchar  disbit[4]  ={ 0xFE, 0xFD,0xFB,0xF7}; //选通值   
/******************************************************************************/
//延时函数
/******************************************************************************/  	                                             							
      void delay(void)   
           {uchar i;
             for(i=0;i<255;i++);
           }
/******************************************************************************/
//显示函数
/******************************************************************************/  
	  void Display(void)
         {  
		    uchar i;
            for(i=0;i<4;i++)
                {
		         PORTB=discode[disbuf[i]];
                 PORTA=disbit[i];
                 delay();
                 PORTA=0xff;
			    } 
		 }
/******************************************************************************/
//主函数不断扫描数码管
/******************************************************************************/  
	  void main (void)
             { 
                  DDRA=0xFF;       //设为输出口     
                  DDRB=0xFF;       //设为输出口 
		          PORTA=0xFF;      
                  PORTB=0xFF;
  
                  while(1)
                 {    
				    Display();  
			      }
			 }
				 	

                      
                      
                       
                            
               
