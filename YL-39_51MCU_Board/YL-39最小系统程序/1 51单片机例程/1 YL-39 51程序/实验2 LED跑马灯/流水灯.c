/****************************************************************************
*   编写时间： 2011.07.07
*   作    者： 雁翎电子
*	版    本：	V1.0
*   函数功能： 跑马灯测试			   			            
*   使用说明： 注意先用跳线冒将J4短接，使用跑马灯模块
*****************************************************************************/
#include<reg52.h>    //包含单片机寄存器的头文件

#define uchar unsigned char
#define uint unsigned int

/* 函数申明 -----------------------------------------------*/
void delay(uint z);

/*
********************************************************************************
** 函数名称 ： main(void)
** 函数功能 ： 主函数
********************************************************************************
*/
void main()
{
	uchar  num,dat1,dat2;
	delay(500);
	P0=0;
	while(1)
	{
		dat1=0xfe;
		dat2=0x7f;
		for(num=0;num<7;num++)
		{
			P1=dat1;	  //初始化赋值
			dat1=dat1<<1; //右移一位
			delay(500);   //延时	
		} 
		for(num=0;num<7;num++)
		{
			P1=dat2;	  //初始化赋值
			dat2=dat2>>1; //右移一位
			delay(500);   //延时	
		}
	}
}

/*
********************************************************************************
** 函数名称 ： delay(uint z)
** 函数功能 ： 延时函数
********************************************************************************
*/
void delay(uint z)
{
    uchar j;
    for(z;z>0;z--)
        for(j=200;j>0;j--);
}