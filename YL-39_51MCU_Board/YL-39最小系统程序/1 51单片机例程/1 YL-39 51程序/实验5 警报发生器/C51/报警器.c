/*********************************************************************************
* 【编写时间】： 2011.07.07
* 【作    者】： 雁翎电子
* 【版    本】： V1.0
* 【网    站】： http://ylelectronic.taobao.com/ 
* 【Q      Q】： 348439350
* 【声    明】： 此程序仅用于学习与参考，引用请注明版权和作者信息！
* 【函数功能】： 蜂鸣器测试程序-报警			   			            			    
* 【使用说明】： J3短路帽接上
**********************************************************************************/

#include <reg51.h>
#include <intrins.h>

#define uchar unsigned char
#define uint  unsigned int

sbit  BEEP=P3^6;

/*********************************************************
 500us延时函数
 晶振：11.0592MHz
*********************************************************/
void delay500(void)
{
  uchar  i;
  for(i=230;i>0;i--);
}

/*********************************************************
 主函数
*********************************************************/
main()
{
  uchar j;
  P0=0x0;
  P1=0xff;
  P2=0xff;
  while(1)
  {
    for(j=200;j>0;j--)
	{
	  BEEP=~BEEP;       //输出频率1KHz
	  delay500();       //延时500us
	}

	for(j=200;j>0;j--)
	{
	  BEEP=~BEEP;       //输出频率500Hz
	  delay500();       //延时1ms
	  delay500();
	}
  }
}

/*********************************************************

信号产生的方法
500Hz信号周期为2ms，信号电平为每1ms变反1次。
1KHz 信号周期为1ms，信号电平每500us变反1次。

**********************************************************/
