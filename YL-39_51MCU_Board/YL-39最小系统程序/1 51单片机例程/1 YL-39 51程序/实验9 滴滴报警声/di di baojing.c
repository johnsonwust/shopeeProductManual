/*********************************************************************************
* 【编写时间】： 2011.07.07
* 【作    者】： 雁翎电子
* 【版    本】： V1.0
* 【网    站】： http://ylelectronic.taobao.com/ 
* 【Q      Q】： 348439350
* 【声    明】： 此程序仅用于学习与参考，引用请注明版权和作者信息！
* 【函数功能】： 蜂鸣器倒车报警			   			            			    
* 【使用说明】： 按下独立按键k6，蜂鸣器发出滴滴倒车报警声
                 按下独立按键k5，蜂鸣器停止警声
**********************************************************************************/

#include <reg51.h>
#include <intrins.h>

#define uchar unsigned char
#define uint  unsigned int

uchar  Count1,Count2;
bit  flag;
	
sbit  K1 = P3^2 ;
sbit  K2 = P3^3 ;
sbit BEEP = P3^6 ;          //蜂鸣器

/********************************************************
 主函数
*********************************************************/
main()
{
   P0=0X0;
   Count1=0x00;
   Count2=0x00;
   BEEP=1;
   flag=0;
   TMOD=0x01; 
   TH0=0xfc; 
   TL0=0x66;      //1ms定时
   EA=1; 
   ET0=1; 

   while(1)
   {
   	  if(K1==0)
   	  {
   	    while(K1==0);
   	    TR0=1;
   	  }  
      if(K2==0)
   	  {
   	    while(K2==0);
   	    TR0=0;
   	  }
   }
}

/*********************************************************
  Time0中断函数
**********************************************************/
void Time0(void) interrupt 1 using 0
{
   TH0=0xfc;               //1ms定时
   TL0=0x66;
   Count1++;
   if(Count1==100)
   {
	 Count2++;
   	 if(Count2==4)
   	 {
   	   Count1=0;
   	   Count2=0;
   	   flag=~flag;
   	 }
   }
   if(!flag)
   {
   	 BEEP=~BEEP;  	 
   }
  
}

/*********************************************************/
