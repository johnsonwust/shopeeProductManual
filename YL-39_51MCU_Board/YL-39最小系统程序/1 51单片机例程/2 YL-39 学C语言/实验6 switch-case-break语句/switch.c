/****************************************************************************
* 【编写时间】： 2011.07.07
* 【作    者】： 雁翎电子
* 【版    本】： V1.0
* 【网    站】： http://ylelectronic.taobao.com/ 
* 【Q      Q】： 348439350		
*****************************************************************************
程序功能：	通过实例说明switch语句的功能。特别注意switch语句的格式，在此很容易犯错。	
****************************************************************************/
#include <reg51.h>

sbit k1=P3^2;
sbit k2=P3^3;
sbit k3=P3^4;
sbit k4=P3^5;

void main()
{
	char anjian;
	while(1)   //无条件永远执行大循环
	{
		if(!k1)			  //这些按键按下，就会使anjian变量赋以相应的值。
			anjian=1;
		if(!k2)
			anjian=2;
		if(!k3)
			anjian=3;
		if(!k4)
			anjian=4;

		switch(anjian)	//当按键的值为几，程序就跳转到case几执行指令，让然后跳出
		{//这个大括弧一定不可少
			case 1: P1=0X0F; break;//这个break也不可少
			case 2: P1=0Xf0; break;
			case 3: P1=0X55; break;
			case 4: P1=0Xaa; break;
			default:P1=0X00; break;//这个为当anjian取值为其他值时的结果（注意关键字为default）。
		}						   //又由于在刚定义变量anjian时，变量的值为初始值0，而0不属于上面的数值，
								   //故此时default项即被选中，故刚开机时，为8个LED均亮。
	}
}