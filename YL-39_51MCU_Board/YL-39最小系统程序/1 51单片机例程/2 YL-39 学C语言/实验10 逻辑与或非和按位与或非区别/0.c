/****************************************************************************
* 【编写时间】： 2011.07.07
* 【作    者】： 雁翎电子
* 【版    本】： V1.0
* 【网    站】： http://ylelectronic.taobao.com/ 
* 【Q      Q】： 348439350
			
*****************************************************************************
程序功能：	 通过P1口的展示，对比说明逻辑与或非和按位与或非之间的差别。
              可以让大家对C语言中几个比较容易混淆的逻辑有一个感性的认识！
			 当TX-1C学习板上的K1被按下时，执行的为按位与；
			 当TX-1C学习板上的K2被按下时，执行的为逻辑与；
			 当TX-1C学习板上的K3被按下时，执行的为按位或；
			 当TX-1C学习板上的K4被按下时，执行的为逻辑或。
****************************************************************************/
#include <reg51.h>

sbit K1=P3^2;
sbit K2=P3^3;
sbit K3=P3^4;
sbit K4=P3^5;

void main()
{
	char i=1,j=2;
	while(1)
	{
		if(K1==0)
			P1=i&j;	  //按位与，程序会将1与2均转换为二进制，对于每个位进行与运算，如果结果不为0，则为True
				  //故此时，即为0000 0001&0000 0010=0000 0000，结果为0，学习板所有led会亮	
		else
			P1=0xff;

		if(K2==0)
			P1=i&&j; //逻辑与，只要i和j均不为0，则结果为真（1），即P1=0X01,第一个led灯灭，其他全亮。
		else
			P1=0xff;

		if(K3==0)
			P1=i|j;  //位或逻辑 0000 0001 | 0000 0010 =0000 0011。
		else
			P1=0xff;

		if(K4==0)   //逻辑或 只要i和j有一个不为0，则结果为真（1） 即P1=0X01,第一个led灯灭，其他全亮。	逻辑与和逻辑或的值 只有0和1 2种状态 
			P1=i||j;
		else
			P1=0xff;
	}
}
